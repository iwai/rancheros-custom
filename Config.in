## Config.in
```kconfig
source "$BR2_EXTERNAL_RANCHEROS_EXT_PATH/package/google-authenticator-libpma/Config.in"
```

## br2ext/Config.in
```kconfig
source "$BR2_EXTERNAL_RANCHEROS_EXT_PATH/package/google-authenticator-libpam/Config.in"
```

## br2ext/package/google-authenticator-libpam/Config.in
```kconfig
config BR2_PACKAGE_GOOGLE_AUTHENTICATOR_LIBPAM
	bool "google-authenticator-libpam"
	select BR2_PACKAGE_LINUX_PAM
	help
	  PAM module for two-factor authentication

	  https://github.com/google/google-authenticator-libpam
```

## package/google-authenticator-libpam/Config.in
```kconfig
config BR2_PACKAGE_GOOGLE_AUTHENTICATOR_LIBPAM
	bool "google-authenticator-libpam"
	help
	  PAM module for two-factor authentication

	  https://github.com/google/google-authenticator-libpam
```
